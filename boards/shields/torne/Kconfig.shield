## boards/shields/torne/Kconfig.shield
```kconfig
config SHIELD_TORNE
    def_bool $(shields_list_contains,torne)

config SHIELD_TORNE_LEFT
    def_bool $(shields_list_contains,torne_left)

config SHIELD_TORNE_RIGHT
    def_bool $(shields_list_contains,torne_right)
```
